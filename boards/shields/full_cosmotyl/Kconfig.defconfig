## boards/shields/full_cosmotyl/Kconfig.defconfig
```kconfig
If SHIELD_FULL_COSMOTYL_LEFT

config ZMK_KEYBOARD_NAME
    default "full-cosmotyl"

config ZMK_SPLIT_ROLE_CENTRAL
    default y

endif # SHIELD_FULL_COSMOTYL_LEFT

if SHIELD_FULL_COSMOTYL_LEFT || SHIELD_FULL_COSMOTYL_RIGHT

config ZMK_SPLIT
    default y

endif # SHIELD_FULL_COSMOTYL_LEFT || SHIELD_FULL_COSMOTYL_RIGHT
```

## boards/shields/full_cosmotyl/Kconfig.shield
```kconfig
config SHIELD_FULL_COSMOTYL_LEFT
    def_bool $(shields_list_contains,full_cosmotyl_left)

config SHIELD_FULL_COSMOTYL_RIGHT
    def_bool $(shields_list_contains,full_cosmotyl_right)
```
