// This file was generated from a template. Edit it to match your keyboard.
// See https://zmk.dev/docs/development/hardware-integration/new-shield for more
// instructions.

#include "full_cosmotyl.dtsi"

&kscan {
    // Replace these comments with the GPIO pins in the matrix for the left side.
    // See https://zmk.dev/docs/development/hardware-integration/new-shield#shield-overlays
    diode-direction = "col2row";

    col-gpios
        = <&pro_micro 10 GPIO_ACTIVE_HIGH>
        , <&pro_micro 16 GPIO_ACTIVE_HIGH>
        , <&pro_micro 14 GPIO_ACTIVE_HIGH>
        , <&pro_micro 15 GPIO_ACTIVE_HIGH>
        , <&pro_micro 18 GPIO_ACTIVE_HIGH>
        , <&pro_micro 19 GPIO_ACTIVE_HIGH>
        , <&pro_micro 20 GPIO_ACTIVE_HIGH>
        ;

    row-gpios
        = <&pro_micro 9 (GPIO_PULL_DOWN | GPIO_ACTIVE_HIGH)>
        , <&pro_micro 8 (GPIO_PULL_DOWN | GPIO_ACTIVE_HIGH)>
        , <&pro_micro 7 (GPIO_PULL_DOWN | GPIO_ACTIVE_HIGH)>
        , <&pro_micro 6 (GPIO_PULL_DOWN | GPIO_ACTIVE_HIGH)>
        , <&pro_micro 5 (GPIO_PULL_DOWN | GPIO_ACTIVE_HIGH)>
        , <&pro_micro 4 (GPIO_PULL_DOWN | GPIO_ACTIVE_HIGH)>;
};

/* The Sharp LS0xx memory-in-pixel LCD needs VCOM polarity toggled every ~1s
 * to prevent the image from fading. nice_view's stock overlay doesn't wire
 * EXTCOMIN to a GPIO on this board, so without serial-vcom-inversion the
 * driver never toggles VCOM and the display appears to "go to sleep" (really,
 * it just fades) after a minute or so of no LVGL redraws. Turning on serial
 * inversion makes the driver fire periodic SPI commands on its own thread. */
&nice_view {
    serial-vcom-inversion;
    serial-vcom-interval = <1000>;
};
